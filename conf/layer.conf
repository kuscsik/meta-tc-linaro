## conf/layer.conf
```bitbake
BBPATH .= ":${LAYERDIR}"


PATH := "${LAYERDIR}/bin:${PATH}"

#define the alternative toolchain
SECONDARYTC = 'linaro'

# Enable the secondary toolchain.
INHERIT += 'tc-secondary tc-blacklist'
```
